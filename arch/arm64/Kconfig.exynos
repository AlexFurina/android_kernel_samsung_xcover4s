## arch/arm64/Kconfig.exynos
```kconfig
config MACH_EXYNOS7885_XCOVER4S_OPEN
	bool "Build Dtbo img for XCover4s"
	depends on SOC_EXYNOS7885
	default n
	help
	Say Y here if you want to enable building dtbo for galaxy XCover4s.
```
